## config/west.yml
```yaml
manifest:
  remotes:
    - name: zmkfirmware
      url-base: https://github.com/zmkfirmware
    - name: refil
      url-base: https://github.com/refil
  projects:
    - name: zmk
      remote: refil
      revision: adv360-z3.5-2
      import:
        file: app/west.yml
        name-allowlist:
          - zephyr
          - cmsis
          - hal_nordic
          - tinycrypt
          - lvgl
          - segger
          - nanopb
          - zmk-studio-messages
  self:
    path: config
```

## tandem/zmk-tandem/Kconfig
```kconfig
config TANDEM_AUTOFLASH
    bool "Tandem automatic flashing"
    depends on USB_CDC_ACM
    select CDC_ACM_DTE_RATE_CALLBACK_SUPPORT
    help
      Adds a USB serial port that the Tandem app uses to flash this half
      without key presses. Setting the port to 1200 baud reboots into the
      UF2 bootloader. Writing "info" returns one JSON line with the build ID,
      and writing "keymap" returns the keymap source this firmware was built
      from. On the left half, writing "boot right" reboots the right half into
      its bootloader over the split link.

if TANDEM_AUTOFLASH

config TANDEM_BUILD_ID
    string "Build ID reported to the Tandem app"
    default "dev"

config TANDEM_REPO
    string "GitHub repo this firmware was built from, as owner/name"
    default ""

endif

config TANDEM_RECONNECT
    bool "Let every paired host reconnect over Bluetooth"
    default y
    depends on ZMK_BLE && (!ZMK_SPLIT || ZMK_SPLIT_ROLE_CENTRAL)
    # It checks for advertising by starting it. With extended advertising, a
    # failed start makes Zephyr forget the advertiser that's running.
    depends on !BT_EXT_ADV
    help
      ZMK advertises only while the active profile's host is away, so a host
      paired on another profile that loses its connection can't reconnect
      while the active host stays connected. ZMK also gives up if the radio
      refuses to start advertising. This checks every few seconds, and
      advertises whenever a paired host is away.

config TANDEM_RECONNECT_INTERVAL
    int "Seconds between checks"
    default 5
    depends on TANDEM_RECONNECT

config TANDEM_RECONNECT_FAST_SECONDS
    int "Seconds to advertise fast for a host on another profile"
    default 30
    depends on TANDEM_RECONNECT
    help
      For this long after a host on another profile goes away, the keyboard
      advertises as fast as ZMK does, every 100 to 150 ms, so a short drop
      recovers in about a second. After that it advertises every 1 to 1.2 s,
      and the host takes a few seconds to reconnect once it's back.
```
